/** @file persistence_platform_slot_test.c
 * @brief Real STM32 platform maintenance-slot tests with synthetic HAL registers only.
 * No App/Core producer, device, serial, flash, EEPROM or power-cycle evidence is used. */
#include <assert.h>
#include <stdio.h>
#include <string.h>
#include "motor_parameter_persistence.h"
#include "../../App/Platform/stm32_platform.c"

static FDCAN_GlobalTypeDef fake_registers;
FDCAN_HandleTypeDef hfdcan1;
uint32_t single_fake_irq_mask;
static uint32_t fake_tick, fake_tx_calls, fake_abort_calls, fake_fifo0, fake_fifo1;
static uint32_t fake_buffer, fake_free_level;
static uint8_t fake_hal_failure, fake_skip_pending, fake_keep_old_bto, fake_keep_old_bcf, fake_abort_failure;
static FDCAN_TxHeaderTypeDef fake_header;
static uint8_t fake_payload[8];
static unsigned submitted_calls;
static uint8_t submitted_allowed, submitted_inject_rx;
static MotorPersistenceIdentity submitted_identity;
static uint64_t submitted_boundary;

/** @brief Preserve the exact prior interrupt mask after every production critical section. */
void single_fake_restore_irq(uint32_t value) { single_fake_irq_mask = value; }
/** @brief Accept setup without emitting traffic. */
HAL_StatusTypeDef HAL_FDCAN_ConfigFilter(FDCAN_HandleTypeDef *handle, const FDCAN_FilterTypeDef *filter)
{ (void)handle; (void)filter; return HAL_OK; }
/** @brief Accept unchanged exact-filter policy. */
HAL_StatusTypeDef HAL_FDCAN_ConfigGlobalFilter(FDCAN_HandleTypeDef *handle, uint32_t a, uint32_t b, uint32_t c, uint32_t d)
{ (void)handle; (void)a; (void)b; (void)c; (void)d; return HAL_OK; }
/** @brief Accept existing RX watermark configuration. */
HAL_StatusTypeDef HAL_FDCAN_ConfigFifoWatermark(FDCAN_HandleTypeDef *handle, uint32_t fifo, uint32_t count)
{ (void)handle; (void)fifo; (void)count; return HAL_OK; }
/** @brief Start means initialized transport only. */
HAL_StatusTypeDef HAL_FDCAN_Start(FDCAN_HandleTypeDef *handle) { (void)handle; return HAL_OK; }
/** @brief Stop does not clear synthetic unresolved pending debt. */
HAL_StatusTypeDef HAL_FDCAN_Stop(FDCAN_HandleTypeDef *handle) { (void)handle; return HAL_OK; }
/** @brief No RTOS notifications are generated by the mock. */
HAL_StatusTypeDef HAL_FDCAN_ActivateNotification(FDCAN_HandleTypeDef *handle, uint32_t mask, uint32_t buffer)
{ (void)handle; (void)mask; (void)buffer; return HAL_OK; }
/** @brief Record HAL admission separately from later TXBRP/TXBTO/TXBCF observations. */
HAL_StatusTypeDef HAL_FDCAN_AddMessageToTxFifoQ(FDCAN_HandleTypeDef *handle,
    const FDCAN_TxHeaderTypeDef *header, const uint8_t *payload)
{
    (void)handle; ++fake_tx_calls; fake_header = *header;
    memset(fake_payload, 0, sizeof(fake_payload));
    memcpy(fake_payload, payload, header->DataLength >> 16U);
    if (!fake_skip_pending) fake_registers.TXBRP |= 0x100U;
    if (!fake_keep_old_bto) fake_registers.TXBTO &= ~0x100U;
    if (!fake_keep_old_bcf) fake_registers.TXBCF &= ~0x100U;
    return fake_hal_failure ? HAL_ERROR : HAL_OK;
}
/** @brief Free FIFO capacity is independently controlled rather than inferred as TX success. */
uint32_t HAL_FDCAN_GetTxFifoFreeLevel(FDCAN_HandleTypeDef *handle)
{ (void)handle; return fake_free_level; }
/** @brief Both raw RX FIFOs can independently contain pre-submit backlog. */
uint32_t HAL_FDCAN_GetRxFifoFillLevel(FDCAN_HandleTypeDef *handle, uint32_t fifo)
{ (void)handle; return fifo == FDCAN_RX_FIFO0 ? fake_fifo0 : fake_fifo1; }
/** @brief Expose a correct, missing or malformed HAL buffer identity. */
uint32_t HAL_FDCAN_GetLatestTxFifoQRequestBuffer(FDCAN_HandleTypeDef *handle)
{ (void)handle; return fake_buffer; }
/** @brief Abort requests never clear TXBRP; actual termination is a separate observation. */
HAL_StatusTypeDef HAL_FDCAN_AbortTxRequest(FDCAN_HandleTypeDef *handle, uint32_t mask)
{ (void)handle; assert(mask != 0U); ++fake_abort_calls; return fake_abort_failure ? HAL_ERROR : HAL_OK; }
/** @brief Tests inject software inbox frames directly; no real RX is consumed. */
HAL_StatusTypeDef HAL_FDCAN_GetRxMessage(FDCAN_HandleTypeDef *handle, uint32_t fifo,
    FDCAN_RxHeaderTypeDef *header, uint8_t *payload)
{ (void)handle; (void)fifo; (void)header; (void)payload; return HAL_ERROR; }
/** @brief Existing strict-slot timestamp setup remains available in the combined build. */
HAL_StatusTypeDef HAL_FDCAN_ConfigTimestampCounter(FDCAN_HandleTypeDef *handle, uint32_t value)
{ (void)handle; (void)value; return HAL_OK; }
/** @brief Timestamp mode is untouched by maintenance submission. */
HAL_StatusTypeDef HAL_FDCAN_EnableTimestampCounter(FDCAN_HandleTypeDef *handle, uint32_t value)
{ (void)handle; (void)value; return HAL_OK; }
/** @brief Maintenance does not use physical SOF timestamps. */
uint16_t HAL_FDCAN_GetTimestampCounter(const FDCAN_HandleTypeDef *handle) { (void)handle; return 0U; }
/** @brief No maintenance operation consumes the strict motion TX event FIFO. */
HAL_StatusTypeDef HAL_FDCAN_GetTxEvent(FDCAN_HandleTypeDef *handle, FDCAN_TxEventFifoTypeDef *event)
{ (void)handle; (void)event; return HAL_ERROR; }
/** @brief Preserve the old single-static timing admission calculation. */
uint32_t HAL_RCCEx_GetPeriphCLKFreq(uint32_t peripheral) { (void)peripheral; return 80000000U; }
/** @brief HAL millisecond time is only used by existing paths. */
uint32_t HAL_GetTick(void) { return fake_tick; }
/** @brief USB is never used by this offline test. */
uint8_t CDC_Transmit_HS(uint8_t *data, uint16_t length) { (void)data; (void)length; return USBD_OK; }

/** @brief Accept or revoke final immutable ownership while the actual platform holds IRQ masked. */
static uint8_t record_submitted(const MotorPersistenceIdentity *identity, uint64_t boundary_us)
{
    assert(single_fake_irq_mask == 1U); ++submitted_calls;
    submitted_identity = *identity; submitted_boundary = boundary_us;
    if (submitted_inject_rx) fake_fifo1 = 1U;
    return submitted_allowed;
}

#ifndef STM32_PLATFORM_PERSISTENCE_API_VERSION
/** @brief RED-only adapter reproduces the old bare-byte dispatch, exposing overlapping collector theft. */
static uint8_t stm32_platform_can_submit_persistence(const CanFrame *frame,
    const MotorPersistenceIdentity *identity, uint64_t now_us, uint64_t timeout_us,
    uint8_t (*submitted)(const MotorPersistenceIdentity *, uint64_t))
{
    (void)identity; (void)now_us; (void)timeout_us; (void)submitted;
    if (stm32_platform_can_submit(CAN_TX_PRIORITY_PARAMETER, frame) != CAN_TX_SCHEDULER_STATUS_OK) return 0U;
    return (uint8_t)(stm32_platform_can_service_tx(1U) == STM32_PLATFORM_STATUS_OK);
}
#endif

/** @brief Reset deterministic registers and initialize the actual production platform. */
static void fixture(void)
{
    memset(&fake_registers, 0, sizeof(fake_registers)); memset(&hfdcan1, 0, sizeof(hfdcan1));
    hfdcan1.Instance = &fake_registers; hfdcan1.Init.StdFiltersNbr = 7U;
    hfdcan1.Init.TxFifoQueueElmtsNbr = 8U; hfdcan1.Init.TxEventsNbr = 8U;
    hfdcan1.Init.NominalPrescaler = 1U; hfdcan1.Init.NominalTimeSeg1 = 59U; hfdcan1.Init.NominalTimeSeg2 = 20U;
    fake_tick = 10U; fake_tx_calls = fake_abort_calls = fake_fifo0 = fake_fifo1 = 0U;
    fake_buffer = 0x100U; fake_free_level = 8U; single_fake_irq_mask = 0U;
    fake_hal_failure = fake_skip_pending = fake_keep_old_bto = fake_keep_old_bcf = fake_abort_failure = 0U;
    submitted_calls = 0U; submitted_allowed = 1U; submitted_inject_rx = 0U; submitted_boundary = 0ULL;
    assert(stm32_platform_init(arm_config_get_production()) == STM32_PLATFORM_STATUS_OK);
}
/** @brief Construct an exact read frame from the unchanged fixed module RID list. */
static CanFrame read_frame(unsigned index)
{
    CanFrame frame;
    uint8_t payload[4] = {7U, 0U, 0x33U, motor_persistence_rid(index)};
    assert(can_frame_init(&frame, 0x7FFU, payload, 4U) == CAN_FRAME_STATUS_OK); return frame;
}
/** @brief Produce a nonzero complete identity, never derived from frame bytes. */
static MotorPersistenceIdentity identity_for(unsigned sequence)
{
    MotorPersistenceIdentity identity = {31U, 42U, 53U, sequence, MOTOR_PERSISTENCE_BASELINE}; return identity;
}
/** @brief Every overlapping RID stays exclusively in the explicitly identified maintenance path. */
static void collector_overlap(void)
{
    unsigned index;
    for (index = 0U; index < MOTOR_PERSISTENCE_REGISTER_COUNT; ++index) {
        CanFrame frame = read_frame(index), stolen;
        MotorPersistenceIdentity identity = identity_for(index + 1U);
        uint8_t succeeded;
        fixture();
        assert(stm32_platform_can_submit_persistence(&frame, &identity, 10000ULL,
            MOTOR_PERSISTENCE_FRAME_BUDGET_US, record_submitted));
        fake_registers.TXBRP = 0U; fake_registers.TXBTO = 0x100U;
        assert(!stm32_platform_can_collect_capability_receipt(&stolen, &succeeded));
#ifdef STM32_PLATFORM_PERSISTENCE_API_VERSION
        {
            MotorPersistenceIdentity receipt; uint64_t observed;
            assert(stm32_platform_can_collect_persistence(&receipt, 10050ULL, &observed, &succeeded));
            assert(succeeded && observed == 10050ULL && motor_persistence_identity_equal(&identity, &receipt));
            assert(fake_tx_calls == 1U && submitted_calls == 1U);
            assert(fake_header.Identifier == 0x7FFU && fake_header.TxEventFifoControl == FDCAN_NO_TX_EVENTS);
        }
#endif
    }
    puts("PERSISTENCE_PLATFORM_COLLECTOR_OVERLAP_PASS reads=45 old_collector_stole_none=1");
}

#ifdef STM32_PLATFORM_PERSISTENCE_API_VERSION
/** @brief Receipt identity/frame remain immutable; HAL acceptance and pending never complete the slot. */
static void immutable_completion(void)
{
    CanFrame frame = read_frame(1U), original = frame;
    MotorPersistenceIdentity identity = identity_for(8U), frozen = identity, receipt;
    uint64_t observed = 77ULL; uint8_t succeeded = 9U;
    fixture(); single_fake_irq_mask = 1U;
    assert(stm32_platform_can_submit_persistence(&frame, &identity, 10000ULL, 100000ULL, record_submitted));
    assert(single_fake_irq_mask == 1U); single_fake_irq_mask = 0U;
    memset(&frame, 0, sizeof(frame)); memset(&identity, 0, sizeof(identity));
    assert(!memcmp(fake_payload, original.data, 4U));
    assert(motor_persistence_identity_equal(&submitted_identity, &frozen) && submitted_boundary == 10000ULL);
    assert(!stm32_platform_can_collect_persistence(&receipt, 10001ULL, &observed, &succeeded));
    assert(observed == 77ULL && !stm32_platform_can_is_idle());
    assert(!stm32_platform_can_submit_persistence(&original, &frozen, 10002ULL, 100000ULL, record_submitted));
    assert(stm32_platform_can_service_tx(8U) == STM32_PLATFORM_STATUS_OK && fake_tx_calls == 1U);
    fake_registers.TXBRP = 0U; fake_registers.TXBTO = 0x100U;
    assert(!stm32_platform_can_submit_persistence(&original, &frozen, 12344ULL, 100000ULL, record_submitted));
    assert(stm32_platform_can_collect_persistence(&receipt, 12345ULL, &observed, &succeeded));
    assert(succeeded && observed == 12345ULL && motor_persistence_identity_equal(&receipt, &frozen));
    assert(!stm32_platform_can_collect_persistence(&receipt, 12346ULL, &observed, &succeeded));
    assert(stm32_platform_can_is_idle());
    puts("PERSISTENCE_PLATFORM_IDENTITY_PASS immutable=1 callback_irq=1 hal_pending_not_success=1 single_collect=1 observation_not_sof=1");
}
/** @brief A later genuine pending observation can establish proof, while no pending or cancelled hardware cannot. */
static void delayed_pending_and_cancelled_hardware(void)
{
    unsigned condition;
    for (condition = 0U; condition < 3U; ++condition) {
        CanFrame frame = read_frame(1U); MotorPersistenceIdentity identity = identity_for(2U), receipt;
        uint64_t observed; uint8_t succeeded;
        fixture(); fake_skip_pending = 1U;
        assert(stm32_platform_can_submit_persistence(&frame, &identity, 10000ULL, 100000ULL, record_submitted));
        if (condition != 1U) {
            fake_registers.TXBRP = 0x100U;
            assert(!stm32_platform_can_collect_persistence(&receipt, 10001ULL, &observed, &succeeded));
        }
        fake_registers.TXBRP = 0U; fake_registers.TXBTO = 0x100U;
        if (condition == 2U) fake_registers.TXBCF = 0x100U;
        if (condition == 1U) {
            assert(!stm32_platform_can_collect_persistence(&receipt, 10002ULL, &observed, &succeeded));
            assert(!stm32_platform_can_is_idle()); /* No pending was observed: old or uncorrelated BTO cannot release ownership. */
        } else {
            assert(stm32_platform_can_collect_persistence(&receipt, 10002ULL, &observed, &succeeded));
            assert(succeeded == (condition == 0U));
        }
    }
    puts("PERSISTENCE_PLATFORM_PENDING_PROOF_PASS delayed_pending=1 never_pending=1 TXBCF_overrides_TXBTO=1");
}
/** @brief HAL-accepted TXBAR may precede the first visible pending bit; only a later trusted lifecycle releases ownership. */
static void scan_delay_lifetime(void)
{
    unsigned condition;
    for (condition = 0U; condition < 9U; ++condition) {
        CanFrame frame = read_frame(1U); MotorPersistenceIdentity identity = identity_for(2U), receipt;
        uint64_t observed = 77ULL, now = 10001ULL; uint8_t succeeded = 9U;
        fixture(); fake_skip_pending = 1U;
        if (condition == 4U) { fake_keep_old_bto = 1U; fake_registers.TXBTO = 0x100U; }
        if (condition == 5U) { fake_keep_old_bcf = 1U; fake_registers.TXBCF = 0x100U; }
        if (condition == 6U) fake_buffer = 0U;
        if (condition == 7U) fake_buffer = 0x300U;
        if (condition == 8U) fake_hal_failure = 1U;
        assert(stm32_platform_can_submit_persistence(&frame, &identity, 10000ULL, 100000ULL, record_submitted));
        if (condition == 1U) assert(stm32_platform_can_cancel_persistence(&identity));
        if (condition == 2U) now = 110000ULL;
        if (condition == 3U) platform_can_rx_inbox.bus_off_latched = 1U;
        if (condition == 8U) {
            /* Real HAL refusal never wrote TXBAR and no pending debt appeared: fail without an artificial lock. */
            assert(stm32_platform_can_collect_persistence(&receipt, now, &observed, &succeeded) && !succeeded);
            assert(stm32_platform_can_is_idle()); continue;
        }
        assert(!stm32_platform_can_collect_persistence(&receipt, now, &observed, &succeeded));
        assert(observed == 77ULL && succeeded == 9U && !fake_abort_calls);
        assert(!stm32_platform_can_is_idle());
        assert(!stm32_platform_can_submit_persistence(&frame, &identity, now + 1ULL, 100000ULL, record_submitted));
        assert(stm32_platform_can_service_tx(1U) == (condition == 3U ? STM32_PLATFORM_STATUS_CAN_BUS_OFF : STM32_PLATFORM_STATUS_OK));
        assert(fake_tx_calls == 1U);
        fake_registers.TXBRP = 0x100U;
        assert(!stm32_platform_can_collect_persistence(&receipt, now + 1ULL, &observed, &succeeded));
        assert(fake_abort_calls == (condition == 1U || condition == 2U || condition == 3U || condition == 6U || condition == 7U));
        assert(!stm32_platform_can_collect_persistence(&receipt, now + 2ULL, &observed, &succeeded));
        assert(fake_abort_calls == (condition == 1U || condition == 2U || condition == 3U || condition == 6U || condition == 7U));
        fake_registers.TXBRP = 0U; fake_registers.TXBTO = 0x100U;
        if (condition == 6U || condition == 7U) {
            assert(!stm32_platform_can_collect_persistence(&receipt, now + 3ULL, &observed, &succeeded));
            assert(!stm32_platform_can_is_idle()); /* An accepted request with unknown buffer remains locked. */
        } else {
            assert(stm32_platform_can_collect_persistence(&receipt, now + 3ULL, &observed, &succeeded));
            assert(succeeded == (condition == 0U) && observed == now + 3ULL);
        }
    }
    puts("PERSISTENCE_PLATFORM_SCAN_DELAY_PASS cases=9 zero_status_retains=1 pre_pending_cancel_timeout_busoff_sticky=1 late_pending_abort_once=1 unknown_buffer_locks=1 HAL_refusal_no_debt_fails=1");
}
/** @brief Maintenance ownership blocks strict/ordinary admissions; emergency cancellation retains its pending debt. */
static void competing_admission(void)
{
    CanFrame frame = read_frame(1U), disable, group[ARM_JOINT_COUNT];
    MotorPersistenceIdentity identity = identity_for(2U), receipt;
    DebugUiStaticTxIdentity strict = {0}; uint64_t observed; uint8_t succeeded;
    fixture();
    assert(stm32_platform_can_submit_persistence(&frame, &identity, 10000ULL, 100000ULL, record_submitted));
    assert(stm32_platform_can_submit(CAN_TX_PRIORITY_PARAMETER, &frame) == CAN_TX_SCHEDULER_STATUS_FULL);
    memset(group, 0, sizeof(group));
    assert(stm32_platform_can_submit_control_group(group, ARM_JOINT_COUNT) == CAN_TX_SCHEDULER_STATUS_GROUP_REJECTED);
    assert(!stm32_platform_can_submit_static(&frame, &strict, 100000ULL, NULL));
    assert(!stm32_platform_can_submit_single_static_preflight(&frame, 1U, 2U, 100000ULL, NULL));
    assert(s3519_pack_mode_command(7U, S3519_CONTROL_MODE_MIT, S3519_MODE_COMMAND_DISABLE, &disable) == S3519_CODEC_STATUS_OK);
    assert(stm32_platform_can_submit(CAN_TX_PRIORITY_EMERGENCY, &disable) == CAN_TX_SCHEDULER_STATUS_OK);
    assert(fake_abort_calls == 1U && !stm32_platform_can_collect_persistence(&receipt, 10001ULL, &observed, &succeeded));
    assert(stm32_platform_can_service_tx(1U) == STM32_PLATFORM_STATUS_OK && fake_tx_calls == 1U);
    fake_registers.TXBRP = 0U; fake_registers.TXBTO = 0x100U;
    assert(stm32_platform_can_collect_persistence(&receipt, 10002ULL, &observed, &succeeded) && !succeeded);
    assert(stm32_platform_can_service_tx(1U) == STM32_PLATFORM_STATUS_OK && fake_tx_calls == 2U);
    assert(fake_header.Identifier == 7U && fake_payload[7] == S3519_MODE_COMMAND_DISABLE);
    puts("PERSISTENCE_PLATFORM_COMPETITION_PASS ordinary_group_strict_blocked=1 emergency_cancels=1 waits_for_debt_and_collection=1");
}
/** @brief True TX/RX debt and every other strict reservation block admission before the callback. */
static void admission_debt(void)
{
    unsigned condition;
    for (condition = 0U; condition < 12U; ++condition) {
        CanFrame frame = read_frame(0U); MotorPersistenceIdentity identity = identity_for(1U);
        fixture();
        switch (condition) {
            case 0U: assert(can_tx_scheduler_submit(&platform_can_tx_scheduler, CAN_TX_PRIORITY_PARAMETER, &frame) == CAN_TX_SCHEDULER_STATUS_OK); break;
            case 1U: fake_registers.TXBRP = 0x40U; break;
            case 2U: fake_free_level = 7U; break;
            case 3U: fake_fifo0 = 1U; break;
            case 4U: fake_fifo1 = 1U; break;
            case 5U: assert(can_rx_inbox_push_isr(&platform_can_rx_inbox, &frame) == CAN_RX_INBOX_STATUS_OK); break;
            case 6U: platform_capability_tracker.active = 1U; break;
            case 7U: platform_single_static.active = 1U; break;
            case 8U: platform_pos_terminal.active = 1U; break;
            case 9U: platform_pos_cancel_pending = 0x40U; break;
            case 10U: platform_can_rx_inbox.bus_off_latched = 1U; break;
            default: platform_diagnostics.can_started = 0U; break;
        }
        assert(!stm32_platform_can_submit_persistence(&frame, &identity, 10000ULL, 100000ULL, record_submitted));
        assert(!submitted_calls && !fake_tx_calls);
    }
    puts("PERSISTENCE_PLATFORM_ADMISSION_PASS tx_rx_fifo_inbox_collector_static_pos_cancel_busoff_notstarted=12");
}
/** @brief Cancellation, timeout, clock regression and HAL ambiguity cannot release live debt or succeed on late TXBTO. */
static void failed_completion(void)
{
    unsigned condition;
    for (condition = 0U; condition < 11U; ++condition) {
        CanFrame frame = read_frame(2U); MotorPersistenceIdentity identity = identity_for(3U), receipt, wrong;
        uint64_t observed; uint8_t succeeded; uint64_t now = 10001ULL, completion_now;
        fixture();
        if (condition == 2U) fake_hal_failure = 1U;
        if (condition == 3U) { fake_skip_pending = fake_keep_old_bto = 1U; fake_registers.TXBTO = 0x100U; }
        if (condition == 4U) fake_buffer = 0U;
        if (condition == 5U) fake_buffer = 0x300U;
        if (condition == 6U) submitted_allowed = 0U;
        if (condition == 7U) fake_abort_failure = 1U;
        if (condition == 10U) submitted_inject_rx = 1U;
        assert(stm32_platform_can_submit_persistence(&frame, &identity, 10000ULL, 100000ULL, record_submitted));
        wrong = identity; ++wrong.owner_generation;
        assert(!stm32_platform_can_cancel_persistence(&wrong));
        if (condition == 0U || condition == 7U) {
            assert(stm32_platform_can_cancel_persistence(&identity));
            assert(stm32_platform_can_cancel_persistence(&identity));
        }
        if (condition == 1U) now = 110000ULL;
        if (condition == 8U) now = 9999ULL;
        if (condition == 9U) platform_can_rx_inbox.bus_off_latched = 1U;
        if (condition != 3U && condition != 6U && condition != 10U) {
            assert(!stm32_platform_can_collect_persistence(&receipt, now, &observed, &succeeded));
            assert(!stm32_platform_can_submit_persistence(&frame, &identity, 110001ULL, 100000ULL, record_submitted));
            assert(!stm32_platform_can_is_idle());
            assert(fake_abort_calls == 1U);
        }
        fake_registers.TXBRP = 0U; fake_registers.TXBTO = 0x100U;
        completion_now = condition == 1U ? 110002ULL : 10003ULL;
        if (condition == 3U || condition == 4U || condition == 5U) {
            assert(!stm32_platform_can_collect_persistence(&receipt, completion_now, &observed, &succeeded));
            assert(!stm32_platform_can_is_idle());
        } else {
            assert(stm32_platform_can_collect_persistence(&receipt, completion_now, &observed, &succeeded));
            assert(!succeeded && observed == completion_now && motor_persistence_identity_equal(&identity, &receipt));
        }
        assert(fake_tx_calls == (condition == 6U || condition == 10U ? 0U : 1U));
    }
    puts("PERSISTENCE_PLATFORM_FAILURE_PASS cancel_timeout_hal_staleBTO_invalidbuffer_callback_abortclock_busoff_postcallbackRX=11 pending_debt_pinned=1 lateBTO_before_deadline_no_success=1");
}
/** @brief Only the fixed 45 reads, exact PMAX512/mode2 and AA01 bytes are transport-admissible. */
static void exact_frame_scope(void)
{
    unsigned condition;
    for (condition = 0U; condition < 18U; ++condition) {
        CanFrame frame = read_frame(0U); MotorPersistenceIdentity identity = identity_for(1U), receipt;
        uint64_t observed; uint8_t succeeded; uint64_t now = 10000ULL, timeout = 100000ULL;
        fixture();
        switch (condition) {
            case 0U: frame.length = 8U; frame.data[2] = 0x55U; frame.data[3] = 21U; frame.data[6] = 0U; frame.data[7] = 0x44U; break;
            case 1U: frame.length = 8U; frame.data[2] = 0x55U; frame.data[3] = 10U; frame.data[4] = 2U; break;
            case 2U: frame.data[2] = 0xAAU; frame.data[3] = 1U; break;
            case 3U: frame.identifier = 7U; break;
            case 4U: frame.data[0] = 6U; break;
            case 5U: frame.data[1] = 1U; break;
            case 6U: frame.data[3] = 200U; break;
            case 7U: frame.length = 8U; break;
            case 8U: frame.length = 8U; frame.data[2] = 0x55U; frame.data[3] = 20U; break;
            case 9U: frame.length = 8U; frame.data[2] = 0x55U; frame.data[3] = 21U; break;
            case 10U: frame.data[2] = 0xAAU; frame.data[3] = 0U; break;
            case 11U: identity.boot_epoch = 0U; break;
            case 12U: identity.owner_generation = 0U; break;
            case 13U: identity.sequence = 0U; break;
            case 14U: identity.phase = 0U; break;
            case 15U: now = 0ULL; break;
            case 16U: timeout = 100001ULL; break;
            default: timeout = 0ULL; break;
        }
        assert(stm32_platform_can_submit_persistence(&frame, &identity, now, timeout, record_submitted) == (condition < 3U));
        if (condition < 3U) {
            assert(fake_tx_calls == 1U && !memcmp(frame.data, fake_payload, frame.length));
            fake_registers.TXBRP = 0U; fake_registers.TXBTO = 0x100U;
            assert(stm32_platform_can_collect_persistence(&receipt, 10001ULL, &observed, &succeeded) && succeeded);
        } else assert(!fake_tx_calls && !submitted_calls);
    }
    puts("PERSISTENCE_PLATFORM_FRAME_SCOPE_PASS fixed_writes_save=3 invalid=15");
}
/** @brief Ordinary legacy reads still use only the original six-RID collector after maintenance is inactive. */
static void legacy_collector_regression(void)
{
    unsigned index;
    for (index = 0U; index < MOTOR_CAPABILITY_COUNT; ++index) {
        CanFrame frame, receipt; uint8_t succeeded;
        fixture(); assert(s3519_pack_capability_read(7U, (uint8_t)index, &frame) == S3519_CODEC_STATUS_OK);
        assert(stm32_platform_can_submit(CAN_TX_PRIORITY_PARAMETER, &frame) == CAN_TX_SCHEDULER_STATUS_OK);
        assert(!fake_tx_calls); assert(stm32_platform_can_service_tx(1U) == STM32_PLATFORM_STATUS_OK);
        assert(!stm32_platform_can_collect_capability_receipt(&receipt, &succeeded));
        fake_registers.TXBRP = 0U; fake_registers.TXBTO = 0x100U;
        assert(stm32_platform_can_collect_capability_receipt(&receipt, &succeeded) && succeeded);
        assert(!memcmp(frame.data, receipt.data, 4U));
    }
    puts("PERSISTENCE_PLATFORM_LEGACY_COLLECTOR_PASS original_rids=6");
}
#endif

/** @brief Execute the actual-platform RED overlap witness and all completed slot safety checks. */
int main(void)
{
    collector_overlap();
#ifdef STM32_PLATFORM_PERSISTENCE_API_VERSION
    immutable_completion(); scan_delay_lifetime(); delayed_pending_and_cancelled_hardware(); competing_admission();
    admission_debt(); failed_completion(); exact_frame_scope(); legacy_collector_regression();
#endif
    puts("PERSISTENCE_PLATFORM_SLOT_PASS synthetic_HAL_only=1 no_App_Core_integration=1"); return 0;
}
